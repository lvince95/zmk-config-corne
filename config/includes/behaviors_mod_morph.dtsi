
/ {
    behaviors {
        ss: smart_shift {
            compatible = "zmk,behavior-mod-morph";
            #binding-cells = <0>;

            bindings = <&sk LSHFT>, <&caps_word>;

            mods = <(MOD_LSFT)>;
        };
    };
};