#define COMBO_TERM_FAST 35
#define COMBO_TERM_SLOW 40
#define COMBO_PRIOR_IDLE 100

/ {
  combos {
    compatible = "zmk,combos";

    combo_capsword {
      timeout-ms = <COMBO_TERM_SLOW>;
      require-prior-idle-ms = <COMBO_PRIOR_IDLE>;
      key-positions = <LM1 RM1>;
      layers = <BASE BASE_QWERTY>;
      bindings = <&caps_word>;
    };
  };
};