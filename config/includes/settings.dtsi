&sk {  // sticky-key config
    release-after-ms = <900>;  // release after 0.6s
    quick-release;             // no double capitalization when rolling keys
};

&sl {  // sticky-layer config
    ignore-modifiers;          // allow chording sticky mods & layers
};

&lt {
    // Increase layer tap time
    tapping-term-ms = <300>;

    // Quickly tap-tap-holding the lt button will repeat the tap behavior
    // For example enter-enter-hold, will output multiple enter while you
    // keep holding the key.
    // But holding enter without double tapping, will activate the layer.
     quick-tap-ms = <200>;

     flavor = "balanced";
};

&caps_word { 
    // Allow caps word to continue even when minus or underscore
    // are pressed.
    // Also prevent mod presses from cancelling caps word.
    continue-list = <
      UNDERSCORE MINUS
      LCTRL LALT LGUI LSHFT
      RCTRL RALT RGUI RSHFT
      BACKSPACE
    >;
};

&num_word {
  layers = <NUM_WORD>;
  continue-list = <
    BACKSPACE DELETE DOT COMMA
    SLASH ASTERICK PLUS MINUS EQUAL DOLLAR
    RS(SPACE)
  >
}